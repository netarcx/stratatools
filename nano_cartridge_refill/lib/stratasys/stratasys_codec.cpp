/*
 * Stratasys cartridge codec -- see stratasys_codec.h.
 *
 * EEPROM layout (offsets), from manager.py:
 *   0x00 serial number (binary64, encrypted as part of 0x00-0x40)
 *   0x08 material id (binary64)
 *   0x10 manufacturing lot (20s)
 *   0x24 version (uint16)
 *   0x28 manufacturing date / 0x30 use date
 *   0x38 initial material quantity (binary64)
 *   0x40 plaintext content CRC16
 *   0x46 encrypted content CRC16
 *   0x48 key (8 bytes, cleartext) / 0x50 key CRC16
 *   0x58 current material quantity (binary64, separately encrypted)
 *   0x60 encrypted current-qty CRC16 / 0x62 plaintext current-qty CRC16
 *   0x68 signature (9 bytes)
 */
#include "stratasys_codec.h"
#include "des.h"
#include "pgm_compat.h"
#include <string.h>

// DESX whitening table ("clorox") from crypto.py
static const uint8_t CLOROX[256] PROGMEM = {
    0xBD,0x56,0xEA,0xF2,0xA2,0xF1,0xAC,0x2A,0xB0,0x93,0xD1,
    0x9C,0x1B,0x33,0xFD,0xD0,0x30,0x04,0xB6,0xDC,0x7D,0xDF,
    0x32,0x4B,0xF7,0xCB,0x45,0x9B,0x31,0xBB,0x21,0x5A,0x41,
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    0xFF,0x43,0xAB
};

// CRC-16/ARC table from checksum.py
static const uint16_t CRC_TABLE[256] PROGMEM = {
    0x0000,0xC0C1,0xC181,0x0140,0xC301,0x03C0,0x0280,0xC241,
    0xC601,0x06C0,0x0780,0xC741,0x0500,0xC5C1,0xC481,0x0440,
    0xCC01,0x0CC0,0x0D80,0xCD41,0x0F00,0xCFC1,0xCE81,0x0E40,
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    0x8201,0x42C0,0x4380,0x8341,0x4100,0x81C1,0x8081,0x4040
};

uint16_t stratasys_crc16_update(uint16_t crc, uint8_t b) {
    return (uint16_t)(TBL_U16(CRC_TABLE, (crc ^ b) & 0xFF) ^ (crc >> 8));
}

uint16_t stratasys_crc16(const uint8_t *data, uint8_t len) {
    uint16_t crc = 0;
    for (uint8_t i = 0; i < len; i++) crc = stratasys_crc16_update(crc, data[i]);
    return crc;
}

static uint16_t rd16(const uint8_t *p) { return (uint16_t)(p[0] | ((uint16_t)p[1] << 8)); }
static void wr16(uint8_t *p, uint16_t v) { p[0] = (uint8_t)(v & 0xFF); p[1] = (uint8_t)(v >> 8); }

static void build_whitening_keys(const uint8_t key[16], uint8_t iw[8], uint8_t ow[8]) {
    for (uint8_t i = 0; i < 8; i++) iw[i] = key[8 + i];
    for (uint8_t i = 0; i < 8; i++) ow[i] = 0;
    for (uint8_t i = 0; i < 8; i++) {
        uint8_t c = (uint8_t)(ow[0] ^ ow[1]);
        for (uint8_t j = 0; j < 7; j++) ow[j] = ow[j + 1];
        ow[7] = (uint8_t)(TBL_U8(CLOROX, c) ^ key[i]);
    }
    for (uint8_t i = 0; i < 8; i++) {
        uint8_t c = (uint8_t)(ow[0] ^ ow[1]);
        for (uint8_t j = 0; j < 7; j++) ow[j] = ow[j + 1];
        ow[7] = (uint8_t)(TBL_U8(CLOROX, c) ^ key[i + 8]);
    }
}

void stratasys_build_key(const uint8_t k[8], const uint8_t m[8],
                         const uint8_t u[8], uint8_t key[16]) {
    key[0]  = (uint8_t)~k[0];
    key[1]  = (uint8_t)~k[2];
    key[2]  = (uint8_t)~u[2];
    key[3]  = (uint8_t)~k[6];
    key[4]  = (uint8_t)~m[0];
    key[5]  = (uint8_t)~m[2];
    key[6]  = (uint8_t)~u[6];
    key[7]  = (uint8_t)~m[6];
    key[8]  = (uint8_t)~m[7];
    key[9]  = (uint8_t)~u[1];
    key[10] = (uint8_t)~m[3];
    key[11] = (uint8_t)~m[1];
    key[12] = (uint8_t)~k[7];
    key[13] = (uint8_t)~u[5];
    key[14] = (uint8_t)~k[3];
    key[15] = (uint8_t)~k[1];
}

void stratasys_desx_encrypt(const uint8_t key[16], const uint8_t *pt, uint8_t *ct, uint8_t len) {
    uint8_t iw[8], ow[8];
    build_whitening_keys(key, iw, ow);
    uint64_t subkeys[16];
    des_key_schedule(key, subkeys);   // DES key is key[0:8]
    for (uint8_t b = 0; b < len / 8; b++) {
        uint8_t tmp[8], enc[8];
        // Copy the block out first, so pt and ct are allowed to be the same buffer.
        for (uint8_t i = 0; i < 8; i++) tmp[i] = (uint8_t)(pt[b * 8 + i] ^ iw[i]);
        des_process_block(subkeys, tmp, enc, false);
        for (uint8_t i = 0; i < 8; i++) ct[b * 8 + i] = (uint8_t)(enc[i] ^ ow[i]);
    }
}

void stratasys_desx_decrypt(const uint8_t key[16], const uint8_t *ct, uint8_t *pt, uint8_t len) {
    uint8_t iw[8], ow[8];
    build_whitening_keys(key, iw, ow);
    uint64_t subkeys[16];
    des_key_schedule(key, subkeys);
    for (uint8_t b = 0; b < len / 8; b++) {
        uint8_t tmp[8], dec[8];
        for (uint8_t i = 0; i < 8; i++) tmp[i] = (uint8_t)(ct[b * 8 + i] ^ ow[i]);
        des_process_block(subkeys, tmp, dec, true);
        for (uint8_t i = 0; i < 8; i++) pt[b * 8 + i] = (uint8_t)(dec[i] ^ iw[i]);
    }
}

bool stratasys_decode(uint8_t buf[STRATASYS_EEPROM_LEN],
                      const uint8_t machine[8], const uint8_t uid[8]) {
    // Validate the encrypted-region checksums first (as the printer does), so a
    // garbled read is rejected before we touch anything.
    if (stratasys_crc16(&buf[0x00], 0x40) != rd16(&buf[0x46])) return false;
    if (stratasys_crc16(&buf[0x58], 0x08) != rd16(&buf[0x60])) return false;

    uint8_t key[16];
    stratasys_build_key(&buf[0x48], machine, uid, key);   // key region is cleartext

    stratasys_desx_decrypt(key, &buf[0x00], &buf[0x00], 0x40);
    stratasys_desx_decrypt(key, &buf[0x58], &buf[0x58], 0x08);

    // Validate the plaintext checksums
    if (stratasys_crc16(&buf[0x00], 0x40) != rd16(&buf[0x40])) return false;
    if (stratasys_crc16(&buf[0x58], 0x08) != rd16(&buf[0x62])) return false;

    return true;
}

void stratasys_encode(uint8_t buf[STRATASYS_EEPROM_LEN],
                      const uint8_t machine[8], const uint8_t uid[8]) {
    // Recompute plaintext checksums (content, key, current quantity)
    wr16(&buf[0x40], stratasys_crc16(&buf[0x00], 0x40));
    wr16(&buf[0x50], stratasys_crc16(&buf[0x48], 0x08));
    wr16(&buf[0x62], stratasys_crc16(&buf[0x58], 0x08));

    uint8_t key[16];
    stratasys_build_key(&buf[0x48], machine, uid, key);

    stratasys_desx_encrypt(key, &buf[0x00], &buf[0x00], 0x40);
    stratasys_desx_encrypt(key, &buf[0x58], &buf[0x58], 0x08);

    // Recompute encrypted-region checksums over the freshly-encrypted bytes
    wr16(&buf[0x46], stratasys_crc16(&buf[0x00], 0x40));
    wr16(&buf[0x60], stratasys_crc16(&buf[0x58], 0x08));
}

bool stratasys_validate(const uint8_t eeprom[STRATASYS_EEPROM_LEN],
                        const uint8_t machine[8], const uint8_t uid[8]) {
    uint8_t scratch[STRATASYS_EEPROM_LEN];
    memcpy(scratch, eeprom, STRATASYS_EEPROM_LEN);
    return stratasys_decode(scratch, machine, uid);
}

bool stratasys_refill(uint8_t buf[STRATASYS_EEPROM_LEN],
                      const uint8_t machine[8], const uint8_t uid[8],
                      const uint8_t new_serial[8]) {
    if (!stratasys_decode(buf, machine, uid)) return false;

    memcpy(&buf[STRATASYS_OFF_SERIAL], new_serial, 8);
    memcpy(&buf[STRATASYS_OFF_CURRENT_QTY], &buf[STRATASYS_OFF_INITIAL_QTY], 8);

    stratasys_encode(buf, machine, uid);
    return true;
}
